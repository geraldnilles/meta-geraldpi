## conf/layer.conf
```bitbake
# We have a conf and classes directory, add to BBPATH
BBPATH .= ":${LAYERDIR}"

# We have recipes-* directories, add to BBFILES
BBFILES += "${LAYERDIR}/recipes-*/*/*.bb \
            ${LAYERDIR}/recipes-*/*/*.bbappend"

BBFILE_COLLECTIONS += "meta-geraldpi"
BBFILE_PATTERN_meta-geraldpi = "^${LAYERDIR}/"
BBFILE_PRIORITY_meta-geraldpi = "6"

LAYERDEPENDS_meta-geraldpi = "core"
LAYERSERIES_COMPAT_meta-geraldpi = "hardknott"
```
